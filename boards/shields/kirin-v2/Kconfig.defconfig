## boards/shields/kirin-v2/Kconfig.defconfig
```kconfig
# Copyright (c) 2020 The ZMK Contributors
# SPDX-License-Identifier: MIT

if SHIELD_KIRIN-V2

config ZMK_KEYBOARD_NAME
    default "kirin_v2"

config SPI
    default y
    
endif
```

## boards/shields/kirinv2/Kconfig.defconfig
```kconfig
# Copyright (c) 2020 The ZMK Contributors
# SPDX-License-Identifier: MIT

if SHIELD_KIRINV2

config ZMK_KEYBOARD_NAME
    default "kirinv2"

config SPI
    default y
    
endif
```
